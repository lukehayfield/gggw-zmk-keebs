## config/dts/bindings/input-processor/trackball_rotate.yaml
```yaml
description: Trackball rotation processor
compatible: "zmk,input-processor-trackball-rotate"
```

## config/west.yml
```yaml
manifest:
  defaults:
    revision: v0.3
  remotes:
    - name: zmkfirmware
      url-base: https://github.com/zmkfirmware
    - name: efogdev
      url-base: https://github.com/efogdev
    - name: badjeff
      url-base: https://github.com/badjeff
    - name: caksoylar
      url-base: https://github.com/caksoylar
    - name: lukehayfield
      url-base: https://github.com/lukehayfield
  projects:
    - name: zmk
      remote: zmkfirmware
      import: app/west.yml
    - name: zmk-pmw3610-driver
      remote: lukehayfield
      revision: zephyr-4.1
    - name: zmk-report-rate-limit
      remote: efogdev
      revision: main
    - name: zmk-input-processor-xyz
      remote: badjeff
      revision: main
  self:
    path: config
```
